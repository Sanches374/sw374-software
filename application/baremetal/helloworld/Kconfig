## bsp/peripheral/Kconfig
```kconfig
source "bsp/peripheral/spinand/Kconfig"
source "bsp/peripheral/spinor_sfud/Kconfig"
source "bsp/peripheral/nftl/Kconfig"

#--------------------------------------------
# touch panel driver global option
#--------------------------------------------

menuconfig AIC_USING_TOUCH
    bool "Touch Panel Support"

if AIC_USING_TOUCH
    choice
        prompt "Select touch device"
            default AIC_USING_CTP

        config AIC_USING_CTP
            bool "CTP"

        config AIC_USING_RTP
            bool "RTP"
            select AIC_RTP_DRV
    endchoice

if AIC_USING_CTP
    source "bsp/peripheral/touch/Kconfig"
endif

if AIC_USING_RTP
    source "bsp/peripheral/touch/rtp/Kconfig"
endif
endif

#--------------------------------------------
# Audio Codec driver option
#--------------------------------------------

menu "External Audio Codec Support"
source "bsp/peripheral/codec/Kconfig"
endmenu
```

## bsp/peripheral/camera/Kconfig
```kconfig
config AIC_USING_CAMERA
    bool "Using camera device"
    default n

choice
    prompt "Select camera device"
    default AIC_USING_CAMERA_OV5640
    depends on AIC_USING_CAMERA && AIC_I2C_DRV

    config AIC_USING_CAMERA_OV7670
        bool "Using camera OV7670"

    config AIC_USING_CAMERA_OV5640
        bool "Using camera OV5640"

    config AIC_USING_CAMERA_OV2659
        bool "Using camera OV2659"

    config AIC_USING_CAMERA_OV2640
        bool "Using camera OV2640"

    config AIC_USING_CAMERA_GM7150
        bool "Using camera GM7150"

    config AIC_USING_CAMERA_TP2825
        bool "Using camera TP2825"
endchoice

config AIC_CAMERA_I2C_CHAN
    int "The No. of I2C channel"
    depends on AIC_USING_CAMERA && AIC_I2C_DRV
    default 0

config AIC_CAMERA_RST_PIN
    string "The reset pin of Camera"
    depends on AIC_USING_CAMERA
    default "PE.14"

config AIC_CAMERA_PWDN_PIN
    string "The power down pin of Camera"
    depends on AIC_USING_CAMERA
    default "PE.15"
```

## bsp/peripheral/touch/axs15260/Kconfig
```kconfig
menu "Axs15260 touch panel options"

config AIC_TOUCH_PANEL_AXS15260
    bool "Using touch panel axs15260"
    default n
    select AIC_I2C_DRV

config AIC_TOUCH_PANEL_AXS15260_I2C_CHA
    string "axs15260 using i2c channel index"
    default "i2c2"
    depends on AIC_TOUCH_PANEL_AXS15260

config AIC_TOUCH_PANEL_AXS15260_RST_PIN
    string "axs15260 reset pin"
    default "PA.10"
    depends on AIC_TOUCH_PANEL_AXS15260

config AIC_TOUCH_PANEL_AXS15260_INT_PIN
    string "axs15260 irq pin"
    default "PA.11"
    depends on AIC_TOUCH_PANEL_AXS15260

endmenu
```

## bsp/peripheral/touch/st16xx/Kconfig
```kconfig
menu "St16xx touch panel options"

config AIC_TOUCH_PANEL_ST16XX
    bool "Using touch panel st16xx"
    default n
    select AIC_I2C_DRV

config AIC_TOUCH_PANEL_ST16XX_I2C_CHA
    string "st16xx using i2c channel index"
    default "i2c3"
    depends on AIC_TOUCH_PANEL_ST16XX

config AIC_TOUCH_PANEL_ST16XX_RST_PIN
    string "st16xx reset pin"
    default "PA.8"
    depends on AIC_TOUCH_PANEL_ST16XX

config AIC_TOUCH_PANEL_ST16XX_INT_PIN
    string "st16xx irq pin"
    default "PA.9"
    depends on AIC_TOUCH_PANEL_ST16XX

endmenu
```

## bsp/peripheral/wireless/asr/Kconfig
```kconfig
#-----------------------------
# asr wlan devices local parameter
#-----------------------------

menu "asr wlan Parameter"

    config AIC_DEV_ASR_RST_GPIO
        string "realtek wlan0 reset on gpio"

endmenu
```

## bsp/peripheral/wireless/rtl8733/Kconfig
```kconfig
config RTL8733_WLAN_DRV
    bool
    default n
    select RT_USING_TIMER_SOFT

config RTL8733_WLAN_INTF_SDIO
    bool
    default n

config RTL8733_WLAN_INTF_USB
    bool
    default n
```
