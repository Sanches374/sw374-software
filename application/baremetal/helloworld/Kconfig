## application/rt-thread/helloworld/user_led/Kconfig
```kconfig
config USER_LED_ON
    bool "Turn on the user LED flashing"
    default n
    help
        More information is available at: https://wiki.lckfb.com/
```

## application/rt-thread/sw374/74hc165/Kconfig
```kconfig
config SW374_74HC165
    bool "USE 74HC165"
    depends on !AIC_USING_I2C0
    default y
```

## application/rt-thread/sw374/Kconfig
```kconfig
comment "Steering Wheel Function Module Code by 374"

menuconfig USING_SW374
    bool "Select the modules need to enable"
    default y
#     help
#         Official Website : www.lckfb.com

# 如果使用立创开发板的模块移植代码则开启下面的选项
if USING_SW374
source "application/rt-thread/sw374/user_led/Kconfig"
# 读取配置文件
source "application/rt-thread/sw374/dfs_file_config/Kconfig"
# 根据配置文件连接wifi
source "application/rt-thread/sw374/wifi_connect/Kconfig"
# 根据配置文件建立TCPserver
source "application/rt-thread/sw374/tcp_server/Kconfig"
# 根据配置文件建立 遥测数据处理器telemetry_data_proccessor
source "application/rt-thread/sw374/telemetry_data_processor/Kconfig"
# LVGL显示屏幕
source "application/rt-thread/sw374/lvgl_ui/Kconfig"
# WS2812B
source "application/rt-thread/sw374/ws2812b/Kconfig"
# rt_thread_class_cpp
source "application/rt-thread/sw374/rt_thread_class_cpp/Kconfig"

# 屏幕驱动显示
# source "application/rt-thread/sw374/lvgl_ui/Kconfig"
# source "application/rt-thread/helloworld/user-bsp/rt_thread_class_cpp/Kconfig"
# source "application/rt-thread/helloworld/user-bsp/ws2812-color-light/Kconfig"
# source "application/rt-thread/helloworld/user-bsp/ec11/Kconfig"
# source "application/rt-thread/helloworld/user-bsp/tcpserver/Kconfig"
# source "application/rt-thread/helloworld/user-bsp/dataprocessor/Kconfig"
# source "application/rt-thread/helloworld/user-bsp/nrf24l01/Kconfig"
# source "application/rt-thread/helloworld/user-bsp/74hc165/Kconfig"

endif # 结束
```

## application/rt-thread/sw374/TCPserver/Kconfig
```kconfig
config SW374_TCP_SERVER
    bool "Using TCP server"
    select SW374_WIFI_CONNECT
    default n
    help
        More information is available at: https://wiki.lckfb.com/
```

## application/rt-thread/sw374/dfs_file_config/Kconfig
```kconfig
config SW374_DFS_FILE_CONFIG
    bool "Using DFS to read/write the config file \'config.conf\'"
    default y
    help
        More information is available at: https://wiki.lckfb.com/
```

## application/rt-thread/sw374/lvgl_ui/Kconfig
```kconfig
config SW374_LVGL_UI
    bool "Using LVGL UI"
    select SW374_TELEMETRY_DATA_PROCESSOR
    default y
#    help
#        More information is available at: https://wiki.lckfb.com/
```

## application/rt-thread/sw374/rt_thread_class_cpp/Kconfig
```kconfig
config SW374_RT_THREAD_CLASS
    bool "Using my rt_thread cpp class"
#    select AIC_USING_QSPI1
    default y
    help
        More information is available at: https://wiki.lckfb.com/
```

## application/rt-thread/sw374/tcp_server/Kconfig
```kconfig
config SW374_TCP_SERVER
    bool "Using TCP server"
    select SW374_WIFI_CONNECT
#    select SW374_TELEMETRY_DATA_PROCESSOR
    default y
    help
        More information is available at: https://wiki.lckfb.com/
```

## application/rt-thread/sw374/telemetry_data_processor/Kconfig
```kconfig
config SW374_TELEMETRY_DATA_PROCESSOR
    bool "Using Telemetry data processor"
    select SW374_TCP_SERVER
    default y
#    help
#        More information is available at: https://wiki.lckfb.com/
```

## application/rt-thread/sw374/wifi_connect/Kconfig
```kconfig
config SW374_WIFI_CONNECT
    bool "Connet to the wifi"
    select SW374_DFS_FILE_CONFIG
    default y
#    help
#        More information is available at: https://wiki.lckfb.com/

#    if SW374_WIFI_CONNECT
#    source "bsp/peripheral/wireless/realtek/Kconfig"
#    endif
```

## application/rt-thread/sw374/ws2812b/Kconfig
```kconfig
config SW374_WS2812B
    bool "Using ws2812 colorful lights"
    select AIC_USING_QSPI1
    select SW374_RT_THREAD_CLASS
    default y
    help
        More information is available at: https://wiki.lckfb.com/
```

## bsp/artinchip/drv/display/panel/Kconfig
```kconfig
menu "Display Panels"

    choice
        prompt "ArtInChip Panel Drivers"
        default AIC_SIMPLE_PANEL

#
# Simple Panel
#
    config AIC_SIMPLE_PANEL
        bool "ArtInChip simple panel"
        depends on AIC_DISP_RGB || AIC_DISP_LVDS
        help
            Simple Panel support general RGB or LVDS LCD

if !AIC_DISP_PQ_TOOL
#
# MIPI-DSI Panel
#
    config AIC_PANEL_DSI_XM91080
        bool "ArtInChip MIPI DSI xm91080 panel"
        depends on AIC_DISP_MIPI_DSI

    config AIC_PANEL_DSI_ST7797
        bool "ArtInChip MIPI DSI st7797 panel"
        depends on AIC_DISP_MIPI_DSI

    config AIC_PANEL_DSI_ST7703
        bool "ArtInChip MIPI DSI st7703 panel"
        depends on AIC_DISP_MIPI_DSI

    config AIC_PANEL_DSI_ILI9881C
        bool "ArtInChip MIPI DSI ili9881c panel"
        depends on AIC_DISP_MIPI_DSI

    config AIC_PANEL_DSI_HX8394
        bool "ArtInChip MIPI DSI hx8394 panel"
        depends on AIC_DISP_MIPI_DSI

    config AIC_PANEL_DSI_JD9365
        bool "ArtInChip MIPI DSI jd9365 panel"
        depends on AIC_DISP_MIPI_DSI
#
# MIPI-DBI Type B I8080 Panel
#
    config AIC_PANEL_DBI_ILI9488
        bool "ArtInChip MIPI DBI ili9488 panel"
        depends on AIC_DISP_MIPI_DBI
        help
            MIPI-DBI Type B, I8080_RGB666_16BIT_3CYCLE

    config AIC_PANEL_DBI_ILI9486L
        bool "ArtInChip MIPI DBI ili9486l panel"
        depends on AIC_DISP_MIPI_DBI
        help
            MIPI-DBI Type B, I8080_RGB666_8BIT

    config AIC_PANEL_DBI_ST7789
        bool "ArtInChip MIPI DBI st7789 panel"
        depends on AIC_DISP_MIPI_DBI
        help
            MIPI-DBI Type B, I8080_RGB565_8BIT
#
# MIPI-DBI Type C SPI Panel
#
    config AIC_PANEL_DBI_ILI9341
        bool "ArtInChip MIPI DBI ili9341 panel"
        depends on AIC_DISP_MIPI_DBI
        help
            MIPI-DBI Type C, SPI_4LINE_RGB888

    config AIC_PANEL_DBI_ST77903
        bool "ArtInChip MIPI DBI st77903 panel"
        depends on AIC_DISP_MIPI_DBI
        help
            MIPI-DBI Type C, SPI_4SDA_RGB666
#
# RGB Panel SPI Init
#
    config AIC_PANEL_RGB_ST7701S
        bool "ArtInChip rgb st7701s panel"
        depends on AIC_DISP_RGB
        select AIC_PANEL_SPI_EMULATION

    config AIC_PANEL_RGB_GC9A01A
        bool "ArtInChip rgb gc9a01a panel"
        depends on AIC_DISP_RGB
        select AIC_PANEL_SPI_EMULATION
#
# SRGB Panel
#
    config AIC_PANEL_SRGB_HX8238
        bool "ArtInChip srgb hx8238 panel"
        depends on AIC_DISP_RGB
#
# Bridge Panel
#
    config AIC_PANEL_BRIDGE_LT8911
        bool "ArtInChip lt8911 LVDS-eDP bridge"
        depends on AIC_DISP_LVDS
endif
    endchoice

if AIC_SIMPLE_PANEL && !AIC_DISP_PQ_TOOL
source "bsp/artinchip/drv/display/panel/Kconfig.timing"
endif

endmenu
```

## bsp/artinchip/drv/ge/Kconfig
```kconfig
#-----------------------------
# devices local parameter
#-----------------------------

choice
    prompt "Select Graphics Engine Mode"
    default AIC_GE_NORMAL
    depends on AIC_GE_DRV

config AIC_GE_CMDQ
    bool "CMD queue mode"
    help
      Enable CMA queue

config AIC_GE_NORMAL
    bool "normal mode"
    help
      Disable CMD Queue

endchoice

menu "Graphics Engine Parameter"
config AIC_GE_DITHER
    bool "Dither function"
    default y
    help
        Turning off the Dither function can save memory about 16K bytes.

config AIC_GE_CMDQ_BUF_LENGTH
    depends on AIC_GE_CMDQ
    int "CMDQ queue buffer"
    range 1024 16384
    default 2048

endmenu
```

## bsp/artinchip/drv/i2c/Kconfig.dev
```kconfig
#-----------------------------
# i2c devices local parameter
#-----------------------------

# i2c0 parameter

menu "I2C0 Parameter"
    depends on AIC_USING_I2C0

    config AIC_DEV_I2C0_ADDR_BIT
        bool "Using I2C0 10-bit Addr(default 7-bit addr)"
        default n

    config AIC_DEV_I2C0_10BIT
       int
       default 1     if AIC_DEV_I2C0_ADDR_BIT
       default 0

    config AIC_DEV_I2C0_SPEED
        bool "Using I2C0 Stand Speed(default fast speed)"
        default n

    config AIC_DEV_I2C0_100K_SPEED
       int
       default 1     if AIC_DEV_I2C0_SPEED
       default 0

    config AIC_DEV_I2C0_BUS_MODE
        bool "Using I2C0 Slave Mode(default master mode)"
        default n

    config AIC_DEV_I2C0_SLAVE_MODE
       int
       default 1     if AIC_DEV_I2C0_BUS_MODE
       default 0

    if AIC_DEV_I2C0_BUS_MODE
        config AIC_DEV_I2C0_SLAVE_ADDR
            int "I2C0 Slave Addr"
    endif

endmenu

# i2c1 parameter

menu "I2C1 Parameter"
    depends on AIC_USING_I2C1

    config AIC_DEV_I2C1_ADDR_BIT
        bool "Using I2C1 10-bit Addr(default 7-bit addr)"
        default n

    config AIC_DEV_I2C1_10BIT
       int
       default 1     if AIC_DEV_I2C1_ADDR_BIT
       default 0

    config AIC_DEV_I2C1_SPEED
        bool "Using I2C1 Stand Speed(default fast speed)"
        default n

    config AIC_DEV_I2C1_100K_SPEED
       int
       default 1     if AIC_DEV_I2C1_SPEED
       default 0

    config AIC_DEV_I2C1_BUS_MODE
        bool "Using I2C1 Slave Mode(default master mode)"
        default n

    config AIC_DEV_I2C1_SLAVE_MODE
       int
       default 1     if AIC_DEV_I2C1_BUS_MODE
       default 0

    if AIC_DEV_I2C1_BUS_MODE
        config AIC_DEV_I2C1_SLAVE_ADDR
            int "I2C1 Slave Addr"
    endif

endmenu

# i2c2 parameter

menu "I2C2 Parameter"
    depends on AIC_USING_I2C2

    config AIC_DEV_I2C2_ADDR_BIT
        bool "Using I2C2 10-bit Addr(default 7-bit addr)"
        default n

    config AIC_DEV_I2C2_10BIT
       int
       default 1     if AIC_DEV_I2C2_ADDR_BIT
       default 0

    config AIC_DEV_I2C2_SPEED
        bool "Using I2C2 Stand Speed(default fast speed)"
        default n

    config AIC_DEV_I2C2_100K_SPEED
       int
       default 1     if AIC_DEV_I2C2_SPEED
       default 0

    config AIC_DEV_I2C2_BUS_MODE
        bool "Using I2C2 Slave Mode(default master mode)"
        default n

    config AIC_DEV_I2C2_SLAVE_MODE
       int
       default 1     if AIC_DEV_I2C2_BUS_MODE
       default 0

    if AIC_DEV_I2C2_BUS_MODE
        config AIC_DEV_I2C2_SLAVE_ADDR
            int "I2C2 Slave Addr"
    endif

endmenu

# i2c3 parameter

menu "I2C3 Parameter"
    depends on AIC_USING_I2C3

    config AIC_DEV_I2C3_ADDR_BIT
        bool "Using I2C3 10-bit Addr(default 7-bit addr)"
        default n

    config AIC_DEV_I2C3_10BIT
       int
       default 1     if AIC_DEV_I2C3_ADDR_BIT
       default 0

    config AIC_DEV_I2C3_SPEED
        bool "Using I2C3 Stand Speed(default fast speed)"
        default n

    config AIC_DEV_I2C3_100K_SPEED
       int
       default 1     if AIC_DEV_I2C3_SPEED
       default 0

    config AIC_DEV_I2C3_BUS_MODE
        bool "Using I2C3 Slave Mode(default master mode)"
        default n

    config AIC_DEV_I2C3_SLAVE_MODE
       int
       default 1     if AIC_DEV_I2C3_BUS_MODE
       default 0

    if AIC_DEV_I2C3_BUS_MODE
        config AIC_DEV_I2C3_SLAVE_ADDR
            int "I2C3 Slave Addr"
    endif

endmenu

menu "I2C4 Parameter"
    depends on AIC_USING_I2C4

    config AIC_DEV_I2C4_ADDR_BIT
        bool "Using I2C4 10-bit Addr(default 7-bit addr)"
        default n

    config AIC_DEV_I2C4_10BIT
       int
       default 1     if AIC_DEV_I2C4_ADDR_BIT
       default 0

    config AIC_DEV_I2C4_SPEED
        bool "Using I2C4 Stand Speed(default fast speed)"
        default n

    config AIC_DEV_I2C4_100K_SPEED
       int
       default 1     if AIC_DEV_I2C4_SPEED
       default 0

    config AIC_DEV_I2C4_BUS_MODE
        bool "Using I2C4 Slave Mode(default master mode)"
        default n

    config AIC_DEV_I2C4_SLAVE_MODE
       int
       default 1     if AIC_DEV_I2C4_BUS_MODE
       default 0

    if AIC_DEV_I2C4_BUS_MODE
        config AIC_DEV_I2C4_SLAVE_ADDR
            int "I2C4 Slave Addr"
    endif

endmenu

menu "SP_I2C Parameter"
    depends on AIC_USING_SP_I2C

    config AIC_DEV_SP_I2C_ADDR_BIT
        bool "Using SP-I2C 10-bit Addr(default 7-bit addr)"
        default n

    config AIC_DEV_SP_I2C_10BIT
       int
       default 1     if AIC_DEV_SP_I2C_ADDR_BIT
       default 0

    config AIC_DEV_SP_I2C_SPEED
        bool "Using SP-I2C Stand Speed(default fast speed)"
        default n

    config AIC_DEV_SP_I2C_100K_SPEED
       int
       default 1     if AIC_DEV_SP_I2C_SPEED
       default 0

    config AIC_DEV_SP_I2C_BUS_MODE
        bool "Using SP-I2C Slave Mode(default master mode)"
        default n

    config AIC_DEV_SP_I2C_SLAVE_MODE
       int
       default 1     if AIC_DEV_SP_I2C_BUS_MODE
       default 0

    if AIC_DEV_SP_I2C_BUS_MODE
        config AIC_DEV_SP_I2C_SLAVE_ADDR
            int "SP-I2C Slave Addr"
    endif

endmenu

# common parameter
```

## bsp/artinchip/drv/qspi/Kconfig.dev
```kconfig
#-----------------------------
# qspi devices local parameter
#-----------------------------

menu "Qspi0 Parameter"
    depends on AIC_USING_QSPI0

    config AIC_DEV_QSPI0_MAX_SRC_FREQ_HZ
        int "Max frequency(Hz)"
        default 100000000

endmenu

menu "Qspi1 Parameter"
    depends on AIC_USING_QSPI1

    config AIC_DEV_QSPI1_MAX_SRC_FREQ_HZ
        int "Max frequency(Hz)"
        default 100000000

endmenu

menu "Qspi2 Parameter"
    depends on AIC_USING_QSPI2

    config AIC_DEV_QSPI2_MAX_SRC_FREQ_HZ
        int "Max frequency(Hz)"
        default 100000000

endmenu

menu "Qspi3 Parameter"
    depends on AIC_USING_QSPI3

    config AIC_DEV_QSPI3_MAX_SRC_FREQ_HZ
        int "Max frequency(Hz)"
        default 100000000

endmenu

source "bsp/artinchip/drv/spinor/Kconfig.dev"
source "bsp/artinchip/drv/spinand/Kconfig.dev"
```

## bsp/artinchip/drv/rtp/Kconfig
```kconfig
#-----------------------------
# RTP devices local parameter
#-----------------------------

menu "RTP parameter"
    depends on AIC_USING_RTP

    config AIC_RTP_PERIOD_MS
        int "The sample period of RTP(in cycle mode)"
        default 15

    config AIC_RTP_MAX_PRESSURE
        int "The pressure threshold of RTP"
        default 800

    config AIC_RTP_X_PLATE
        int "The x-plate value of RTP touchscreen"
        range 0 1024
        default 235

    config AIC_RTP_Y_PLATE
        int "The Y-plate value of RTP touchscreen"
        range 0 1024
        default 0
endmenu
```
