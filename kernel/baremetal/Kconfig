## kernel/baremetal/Kconfig
```kconfig
menu "Baremetal options"

config KERNEL_BAREMETAL
    bool
    default y

config DRIVER_HAL_EN
    bool
    default y

config DRIVER_BARE_DRV_EN
    bool
    default y

config AIC_NORMALSTACK_SIZE
    int "Main loop stack"
    default 8092

if ! AIC_BOOTLOADER
    config AIC_BAREMETAL_CONSOLE_UART
        int "Baremetal console UART ID"
        range 0 8
        default 0
endif

config ARCH_RISCV
    bool

config ARCH_RISCV_FPU
    bool

config ARCH_RISCV_FPU_S
    select ARCH_RISCV_FPU
    bool

config ARCH_RISCV_FPU_D
    select ARCH_RISCV_FPU
    bool

config ARCH_RISCV32
    select ARCH_RISCV
    bool

config ARCH_RISCV64
    select ARCH_RISCV
    select ARCH_CPU_64BIT
    bool

choice
    prompt "Log level"
    default AIC_BAREMETAL_LOG_WARN

config AIC_BAREMETAL_LOG_NONE
    bool "none"

config AIC_BAREMETAL_LOG_ERR
    bool "error"

config AIC_BAREMETAL_LOG_WARN
    bool "warn"

config AIC_BAREMETAL_LOG_INFO
    bool "info"

config AIC_BAREMETAL_LOG_DEBUG
    bool "debug"

endchoice

config AIC_BAREMETAL_LOG_LEVEL
    int
    default 0 if AIC_BAREMETAL_LOG_NONE
    default 3 if AIC_BAREMETAL_LOG_ERR
    default 4 if AIC_BAREMETAL_LOG_WARN
    default 6 if AIC_BAREMETAL_LOG_INFO
    default 7 if AIC_BAREMETAL_LOG_DEBUG

endmenu
```

## packages/artinchip/Kconfig
```kconfig
menu "ArtInChip packages options"

source "packages/artinchip/mpp/Kconfig"
source "packages/artinchip/env/Kconfig"
source "packages/artinchip/userid/Kconfig"
source "packages/artinchip/pinmux-check/Kconfig"
source "packages/artinchip/ota/Kconfig"

endmenu
```

## packages/third-party/freetype/Kconfig
```kconfig
menuconfig LPKG_USING_FREETYPE
    bool "freetype"
    default n

if LPKG_USING_FREETYPE
    config LPKG_USING_FREETYPE_STATIC
        bool "Compile using FREETYPE static link library"
        default n

config TT_DISABLE_LOAD_HDMX
    bool "Disable loading hdmx table"
    default n
endif
```
